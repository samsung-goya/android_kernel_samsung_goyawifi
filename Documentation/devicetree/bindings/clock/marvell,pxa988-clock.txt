## drivers/gpu/drm/etnaviv/Kconfig
```kconfig
config DRM_ETNAVIV
	tristate "ETNAVIV (DRM support for Vivante GPU IP cores)"
	depends on DRM
	depends on ARCH_MXC || ARCH_DOVE || ARCH_MMP || (ARM && COMPILE_TEST)
	depends on MMU
	select SHMEM
	select SYNC_FILE
	select THERMAL if DRM_ETNAVIV_THERMAL
	select TMPFS
	select WANT_DEV_COREDUMP
	select CMA if HAVE_DMA_CONTIGUOUS
	select DMA_CMA if HAVE_DMA_CONTIGUOUS
	select DRM_SCHED
	help
	  DRM driver for Vivante GPUs.

config DRM_ETNAVIV_THERMAL
	bool "enable ETNAVIV thermal throttling"
	depends on DRM_ETNAVIV
	default y
	help
	  Compile in support for thermal throttling.
	  Say Y unless you want to risk burning your SoC.

config DRM_ETNAVIV_GOYA
	bool "Samsung goya board GC1000 devfreq scaling"
	depends on DRM_ETNAVIV && PM_DEVFREQ
	select DEVFREQ_GOV_SIMPLE_ONDEMAND
	help
	  Enable devfreq clock-rate scaling for the Vivante GC1000 GPU on
	  the Samsung goya board.
```

## drivers/gpu/drm/mmp/Kconfig
```kconfig
# SPDX-License-Identifier: GPL-2.0-only
config DRM_MMP
	tristate "DRM Support for Marvell PXA988/MMP Display Controller"
	depends on DRM && OF
	depends on ARCH_MMP || ARCH_MULTI_V7 || COMPILE_TEST
	select DRM_KMS_HELPER
	select DRM_KMS_CMA_HELPER
	select DRM_MIPI_DSI
	select DRM_PANEL
	select DRM_PANEL_BRIDGE
	select VIDEOMODE_HELPERS
	help
	  Choose this option if you have a Marvell PXA988/PXA986/MMP SoC
	  display controller with atomic KMS and MIPI DSI support.

	  If M is selected the module will be called mmp-drm.
```
