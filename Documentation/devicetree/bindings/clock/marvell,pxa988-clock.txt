## Documentation/devicetree/bindings/clock/marvell,pxa988-clock.txt
```
* Marvell PXA988 / PXA986 Clock and Reset Controller

The Marvell PXA988 (and PXA986) clock subsystem generates and supplies clocks
and resets to various controllers within the SoC across the MPMU, APMU, APBC,
APBCP, APBS, and CIU register blocks.

Required Properties:

- compatible: should be "marvell,pxa988-clock".
- reg: physical base addresses and lengths of the MPMU, APMU, APBC, APBCP,
  APBS, and CIU register regions, in that order.
- reg-names: should be "mpmu", "apmu", "apbc", "apbcp", "apbs", "ciu".
- #clock-cells: should be 1.
- #reset-cells: should be 1.

Each clock or reset line is assigned an identifier and client nodes use the
clock controller phandle and this identifier to specify the clock or reset
which they consume.

All these identifiers can be found in <dt-bindings/clock/marvell,pxa988.h>.

Example:

	soc_clocks: clock-controller@d4050000 {
		compatible = "marvell,pxa988-clock";
		reg = <0xd4050000 0x1000>,
		      <0xd4282800 0x0400>,
		      <0xd4015000 0x1000>,
		      <0xd403b000 0x1000>,
		      <0xd4090000 0x1000>,
		      <0xd4282c00 0x0400>;
		reg-names = "mpmu", "apmu", "apbc", "apbcp", "apbs", "ciu";
		#clock-cells = <1>;
		#reset-cells = <1>;
	};
```

## Documentation/devicetree/bindings/display/bridge/quicklogic,vx5b3d.txt
```
QuickLogic VX5B3D MIPI DSI to LVDS Bridge
=========================================

Required properties:
- compatible: "quicklogic,vx5b3d"
- reg: I2C slave address (0x64).
- vdd12-supply: Regulator supplying the 1.2V core rail.
- vdd18-supply: Regulator supplying the 1.8V IO rail.
- ports: OF graph node containing port@0 (MIPI DSI input) and port@1 (LVDS
  panel output).

Optional properties:
- enable-gpios: GPIO specifier for the 3.3V bridge LVDS TX power enable pin.
- reset-gpios: GPIO specifier for the active-low reset pin.
- backlight-enable-gpios: GPIO specifier for the RT8511B LED boost enable pin.
```

## Documentation/devicetree/bindings/display/marvell,pxa988-lcd.txt
```
Marvell PXA988/MMP Display Controller & MIPI DSI Host
======================================================

LCD Controller (LCDC)
---------------------

Required properties:
- compatible: "marvell,pxa988-lcd"
- reg: Physical base address and size of LCDC registers (e.g. 0xd420b000 0x300).
- interrupts: LCDC IRQ specifier.
- clocks: Phandles for the display clocks ("hclk", "axi", "lcd"; optional
  "dsi_phy" and "dsi_esc" when operating in bootloader-takeover mode).
- clock-names: Corresponding names ("hclk", "axi", "lcd", optionally
  "dsi_phy", "dsi_esc").

Optional properties:
- marvell,bootloader-takeover: Retain bootloader-initialized display timings
  and expose a fixed connector for static scanout debugging without
  attaching the MIPI DSI pipeline.
- port: OF graph output port connected to the MIPI DSI host input port.

MIPI DSI Host
-------------

Required properties:
- compatible: "marvell,pxa988-dsi"
- reg: Physical base address and size of MIPI DSI registers (0xd420b800 0x200).
- interrupts: MIPI DSI IRQ specifier.
- clocks: Phandles for "dsi_phy" and "dsi_esc".
- clock-names: "dsi_phy", "dsi_esc".
- ports: OF graph node containing port@0 (input from LCDC) and port@1 (output
  to downstream DSI bridge or panel).
```

## Documentation/devicetree/bindings/display/panel/boe,ba070ws1-400.txt
```
BOE BA070WS1-400 7.0" WSVGA (1024x600) LVDS Panel
===================================================

Required properties:
- compatible: Shall contain "boe,ba070ws1-400" followed by "panel-lvds".

See Documentation/devicetree/bindings/display/panel/panel-lvds.txt for the
remaining generic LVDS panel properties.
```

## Documentation/devicetree/bindings/iio/adc/marvell,88pm822-gpadc.txt
```
Marvell 88PM822 GPADC IIO driver

This node is a child of the Marvell 88PM822 PMIC MFD node (marvell,88pm822).

Required properties:
- compatible: must be "marvell,88pm822-gpadc"

Example:
	pmic@30 {
		compatible = "marvell,88pm822", "marvell,88pm800";
		...
		gpadc {
			compatible = "marvell,88pm822-gpadc";
		};
	};
```

## Documentation/devicetree/bindings/input/touchscreen/zinitix,bt400.txt
```
* Zinitix BT4xx / BT5xx touchscreen controller

Required properties:
- compatible: must be one of:
  - "zinitix,bt400"
  - "zinitix,bt532"
  - "zinitix,bt541"
- reg: I2C slave address of the chip (typically 0x20).
- interrupts: interrupt to which the chip is connected.
- vdd-supply: digital power supply regulator.
- vcca-supply: analog power supply regulator.

Optional properties:
- zinitix,mode: reporting mode used by the firmware (0, 1, or 2).
  Mode 0 uses 6-byte contact records and is used by BT532; mode 2 is
  the default.
- linux,keycodes: array of up to 8 keycodes for capacitive touch buttons
  (use KEY_RESERVED / 0 for unused button slots).
- touchscreen-size-x: see touchscreen.txt
- touchscreen-size-y: see touchscreen.txt
- touchscreen-fuzz-x: see touchscreen.txt
- touchscreen-fuzz-y: see touchscreen.txt
- touchscreen-inverted-x: see touchscreen.txt
- touchscreen-inverted-y: see touchscreen.txt
- touchscreen-swapped-x-y: see touchscreen.txt

Example:

	i2c@d4010800 {
		touchscreen@20 {
			compatible = "zinitix,bt532";
			reg = <0x20>;
			interrupt-parent = <&gpio>;
			interrupts = <94 IRQ_TYPE_EDGE_FALLING>;
			vdd-supply = <&ldo1>;
			vcca-supply = <&ldo1>;
			touchscreen-size-x = <600>;
			touchscreen-size-y = <1024>;
			touchscreen-inverted-x;
			touchscreen-swapped-x-y;
			zinitix,mode = <0>;
			linux,keycodes = <KEY_RESERVED KEY_MENU KEY_BACK KEY_RESERVED>;
		};
	};
```

## Documentation/devicetree/bindings/media/i2c/siliconfile,sr200pc20m.txt
```
Siliconfile SR200PC20M 2MP YUV Camera Sensor

Required properties:
- compatible: "siliconfile,sr200pc20m"
- reg: I2C slave address (0x20)
- clocks: Sensor MCLK clock specifier
- io-enable-gpios: GPIO for 1.8V I/O and core power enable
- analog-enable-gpios: GPIO for 2.8V analog power enable
- standby-gpios: GPIO for sensor standby control
- reset-gpios: GPIO for sensor reset control (active low)
- port: OF graph port node containing an endpoint linked to the receiver.

Example:
	sensor@20 {
		compatible = "siliconfile,sr200pc20m";
		reg = <0x20>;
		clocks = <&ccic>;
		io-enable-gpios = <&gpio 79 GPIO_ACTIVE_HIGH>;
		analog-enable-gpios = <&gpio 80 GPIO_ACTIVE_HIGH>;
		standby-gpios = <&gpio 14 GPIO_ACTIVE_HIGH>;
		reset-gpios = <&gpio 15 GPIO_ACTIVE_LOW>;

		port {
			sensor_out: endpoint {
				remote-endpoint = <&ccic_in>;
				bus-type = <4>;
				clock-lanes = <0>;
				data-lanes = <1>;
			};
		};
	};
```

## Documentation/devicetree/bindings/media/marvell,mmp2-ccic.txt
```
Marvell MMP2 / PXA988 Camera Controller (CCIC)

Required properties:
- compatible: Should be one of:
  - "marvell,mmp2-ccic"
  - "marvell,pxa988-ccic"
- reg: Register base address and length.
- interrupts: CCIC interrupt specifier.
- clocks: List of clock specifiers matching clock-names.
- clock-names: "axi", "func", "phy", and optionally "hclk" (shared LCD/CCIC AHB clock).

Optional properties:
- #clock-cells: Should be <0> if the CCIC provides MCLK to the camera sensor.
- clock-output-names: Name of the sensor MCLK output clock.
- port: OF graph port node containing an endpoint linked to the sensor.

Example:
	ccic: camera@d420a000 {
		compatible = "marvell,pxa988-ccic", "marvell,mmp2-ccic";
		reg = <0xd420a000 0x1000>;
		interrupts = <GIC_SPI 42 IRQ_TYPE_LEVEL_HIGH>;
		clocks = <&soc_clocks PXA988_CLK_CCIC_AXI>,
			 <&soc_clocks PXA988_CLK_CCIC0>,
			 <&soc_clocks PXA988_CLK_CCIC0_PHY>,
			 <&soc_clocks PXA988_CLK_LCD_HCLK>;
		clock-names = "axi", "func", "phy", "hclk";
		#clock-cells = <0>;
		clock-output-names = "cam-mclk";

		port {
			ccic_in: endpoint {
				remote-endpoint = <&sensor_out>;
				clock-lanes = <0>;
				data-lanes = <1>;
			};
		};
	};
```

## Documentation/devicetree/bindings/pinctrl/marvell,pxa988-pinctrl.txt
```
* Marvell PXA988 / PXA986 Pin Controller

The Marvell PXA988 pin controller configures multi-function pins (MFPR) using
the standard pinctrl-single / pinconf-single driver.

Required properties for the pin controller node:
- compatible: "pinconf-single"
- reg: base address and length of the MFPR registers (typically <0xd401e000 0x330>)
- #address-cells: <1>
- #size-cells: <0>
- #pinctrl-cells: <1>
- pinctrl-single,register-width: <32>
- pinctrl-single,function-mask: <7>
- pinctrl-single,gpio-range: reference to gpio-range subnode

Subnodes:
Each subnode represents a pin group and contains:
- pinctrl-single,pins: list of pin register offset and alternate function pairs
- Optional pinconf properties:
  - pinctrl-single,drive-strength
  - pinctrl-single,bias-pullup
  - pinctrl-single,bias-pulldown
  - pinctrl-single,input-schmitt
  - pinctrl-single,input-schmitt-enable
  - pinctrl-single,low-power-mode

Header:
  <dt-bindings/pinctrl/marvell,pxa988-pinfunc.h>
```

## Documentation/devicetree/bindings/power/marvell,pxa988-gc-power.txt
```
Marvell PXA988/PXA986 3D GPU (GC) Power Domain Controller

This binding describes the APMU power domain controller for the Vivante 3D GPU
(GC) block on Marvell PXA988/PXA986 SoCs.

Required properties:
- compatible: Must be "marvell,pxa988-gc-power".
- reg: Four register regions in order:
  1. APMU_GC control register
  2. APMU_PWR_CTRL_REG register
  3. APMU_PWR_BLK_TMR_REG register
  4. APMU_PWR_STATUS_REG register
- reg-names: Must contain "apmu-gc", "pwr-ctrl", "pwr-tmr", "pwr-stat".
- #power-domain-cells: Must be 0.
- clocks: Phandles to the GC register, AXI bus, and core clocks.
- clock-names: Must contain "reg", "bus", "core".

Optional properties:
- power-supply: Phandle to the GPU supply regulator.

Example:
	gc_power: power-controller@d42828cc {
		compatible = "marvell,pxa988-gc-power";
		reg = <0xd42828cc 0x4>,
		      <0xd42828d8 0x4>,
		      <0xd42828dc 0x4>,
		      <0xd42828f0 0x4>;
		reg-names = "apmu-gc", "pwr-ctrl", "pwr-tmr", "pwr-stat";
		clocks = <&soc_clocks PXA988_CLK_GC_HCLK>,
			 <&soc_clocks PXA988_CLK_GC_AXI>,
			 <&soc_clocks PXA988_CLK_GC>;
		clock-names = "reg", "bus", "core";
		#power-domain-cells = <0>;
	};
```

## Documentation/devicetree/bindings/power/supply/marvell,88pm822-battery.txt
```
Marvell 88PM822 Software Fuel-Gauge Battery

This node is a child of the Marvell 88PM822 PMIC MFD node (marvell,88pm822).

Required properties:
- compatible: must be "marvell,88pm822-battery"

Optional properties:
- power-supplies: phandle to the charger power_supply node (e.g. smb328-charger)

Example:
	pmic@30 {
		compatible = "marvell,88pm822", "marvell,88pm800";
		...
		battery: battery {
			compatible = "marvell,88pm822-battery";
			power-supplies = <&charger>;
		};
	};
```

## Documentation/devicetree/bindings/power/supply/summit,smb328.txt
```
Summit Microelectronics SMB328 Battery Charger

Required properties:
- compatible: must be "summit,smb328"
- reg: I2C slave address (typically 0x34)

Optional properties:
- extcon: phandle to an extcon provider (e.g. MUIC) for USB/DCP cable detection
- monitored-battery: phandle to the battery power_supply node
- enable-gpios: optional charger enable GPIO
- interrupts: charger status/fault IRQ
- summit,dcp-input-current-microamp: input current limit for DCP in uA (default 500000)
- summit,fast-charge-current-microamp: fast-charge current limit for DCP in uA (default 500000)
- summit,float-voltage-microvolt: float voltage in uV (default 4320000)

Example:
	charger@34 {
		compatible = "summit,smb328";
		reg = <0x34>;
		extcon = <&muic>;
		monitored-battery = <&battery>;
		enable-gpios = <&gpio 98 GPIO_ACTIVE_LOW>;
		summit,dcp-input-current-microamp = <500000>;
		summit,fast-charge-current-microamp = <500000>;
		summit,float-voltage-microvolt = <4320000>;
	};
```

## Documentation/devicetree/bindings/thermal/marvell,pxa988-thermal.txt
```
Marvell PXA988/PXA986 DROTS Thermal Sensor

Required properties:
- compatible: must be "marvell,pxa988-thermal"
- reg: physical base address and length of the DROTS register block
- clocks: phandle to the PXA988 DROTS thermal clock
- #thermal-sensor-cells: must be <0>

Example:
	thermal: thermal@d4013200 {
		compatible = "marvell,pxa988-thermal";
		reg = <0xd4013200 0x34>;
		clocks = <&soc_clocks PXA988_CLK_THERMAL>;
		#thermal-sensor-cells = <0>;
	};
```
